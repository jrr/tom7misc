<table>
<tr>
<td valign="top"><a href="/f/a/escape/level/1874"><img src="/png/232f4057e79d33c5212af954751ad24a.png"
border=0></a></td>
<td valign="top"><a href="/f/a/escape/level/1874">Nice Cote d'Azur International Airport (NCE) (noname's mod)</a>
<br />by Tom 7, Eric119, noname
<br /><b>difficulty</b>: 9.40
</td></tr>
<tr>
<td valign="top"><a href="/f/a/escape/level/2402"><img src="/png/24720f3db228fde29fb486d522042347.png"
border=0></a></td>
<td valign="top"><a href="/f/a/escape/level/2402">block cipher</a>
<br />by pieguy
<br /><b>difficulty</b>: 9.37
</td></tr>
<tr>
<td valign="top"><a href="/f/a/escape/level/1430"><img src="/png/54c3f177b9d9412d68267d397a90e0ae.png"
border=0></a></td>
<td valign="top"><a href="/f/a/escape/level/1430">Newark Liberty Airport (EWR)</a>
<br />by Tom 7
<br /><b>difficulty</b>: 9.33
</td></tr>
<tr>
<td valign="top"><a href="/f/a/escape/level/670"><img src="/png/8fa772b4baa7f23f54c7efd122578a0c.png"
border=0></a></td>
<td valign="top"><a href="/f/a/escape/level/670">Too Many Lasers</a>
<br />by Henri Kareinen
<br /><b>difficulty</b>: 9.25
</td></tr>
<tr>
<td valign="top"><a href="/f/a/escape/level/885"><img src="/png/49f038ef5f59dbab64f8d88ca155b028.png"
border=0></a></td>
<td valign="top"><a href="/f/a/escape/level/885"><font color="#FF756A">Rouge<font color="#000000">-Like-Like</font></font></a>
<br />by Max (original by Stephan/Tom 7)
<br /><b>difficulty</b>: 9.22
</td></tr>
<tr>
<td valign="top"><a href="/f/a/escape/level/2332"><img src="/png/4961d912a66ee6c5335a6df477572a61.png"
border=0></a></td>
<td valign="top"><a href="/f/a/escape/level/2332">Too Many Lasers again (2 bots)</a>
<br />by Henri Kareinen (mod by wowei) mod by Kirima
<br /><b>difficulty</b>: 9.20
</td></tr>
<tr>
<td valign="top"><a href="/f/a/escape/level/1192"><img src="/png/271a66247ad04d65f74cf92a2a9828e8.png"
border=0></a></td>
<td valign="top"><a href="/f/a/escape/level/1192">Too Many Lasers (2 bots)</a>
<br />by Henri Kareinen (mod by wowei)
<br /><b>difficulty</b>: 9.16
</td></tr>
<tr>
<td valign="top"><a href="/f/a/escape/level/1107"><img src="/png/492f75f17f3a8e9fed74ee149c295527.png"
border=0></a></td>
<td valign="top"><a href="/f/a/escape/level/1107">the wrong parity</a>
<br />by pieguy
<br /><b>difficulty</b>: 9.00
</td></tr>
<tr>
<td valign="top"><a href="/f/a/escape/level/692"><img src="/png/b96e9e78ae2af79bb0b62bc1f1baa5fa.png"
border=0></a></td>
<td valign="top"><a href="/f/a/escape/level/692">revenge of the computers 2</a>
<br />by pieguy
<br /><b>difficulty</b>: 9.00
</td></tr>
<tr>
<td valign="top"><a href="/f/a/escape/level/593"><img src="/png/1ac6873beab6b324dbf4bf5951dfadc9.png"
border=0></a></td>
<td valign="top"><a href="/f/a/escape/level/593">Bigger Waste of Time</a>
<br />by Max (mod by bpotetz)
<br /><b>difficulty</b>: 8.90
</td></tr>
<tr>
<td valign="top"><a href="/f/a/escape/level/457"><img src="/png/5361d3a80ab17c2914cca4d65d3697cc.png"
border=0></a></td>
<td valign="top"><a href="/f/a/escape/level/457">Hugbot Research Lab</a>
<br />by Joshua Bone
<br /><b>difficulty</b>: 8.87
</td></tr>
<tr>
<td valign="top"><a href="/f/a/escape/level/617"><img src="/png/d78a40d89cda1e58e502c3b00ff1865c.png"
border=0></a></td>
<td valign="top"><a href="/f/a/escape/level/617">revenge of the computers 1</a>
<br />by pieguy
<br /><b>difficulty</b>: 8.83
</td></tr>
<tr>
<td valign="top"><a href="/f/a/escape/level/466"><img src="/png/1ead431eed60dd03811f10b52ebbee2c.png"
border=0></a></td>
<td valign="top"><a href="/f/a/escape/level/466">Dimensional Trap 17</a>
<br />by Henri Kareinen (mod by Brian Potetz)
<br /><b>difficulty</b>: 8.60
</td></tr>
<tr>
<td valign="top"><a href="/f/a/escape/level/591"><img src="/png/d80d63ff42c1e193f3ef1a00770d43aa.png"
border=0></a></td>
<td valign="top"><a href="/f/a/escape/level/591">Waste of Time</a>
<br />by Max
<br /><b>difficulty</b>: 8.57
</td></tr>
<tr>
<td valign="top"><a href="/f/a/escape/level/2285"><img src="/png/bbb2569bb8c9c430684c3d272bfdc2aa.png"
border=0></a></td>
<td valign="top"><a href="/f/a/escape/level/2285">Avalanche 2</a>
<br />by John Lewis (original by pieguy)
<br /><b>difficulty</b>: 8.55
</td></tr>
<tr>
<td valign="top"><a href="/f/a/escape/level/362"><img src="/png/a4866e383ed6c75ab4a81a87d163cc29.png"
border=0></a></td>
<td valign="top"><a href="/f/a/escape/level/362">Memoryless Hole (v3)</a>
<br />by mjn (mod by bpotetz)
<br /><b>difficulty</b>: 8.55
</td></tr>
<tr>
<td valign="top"><a href="/f/a/escape/level/3523"><img src="/png/3968c0ed3acf4f8557dbfd15b1967e24.png"
border=0></a></td>
<td valign="top"><a href="/f/a/escape/level/3523">All mod cons 17</a>
<br />by The Mods (Kirima)
<br /><b>difficulty</b>: 8.40
</td></tr>
<tr>
<td valign="top"><a href="/f/a/escape/level/2190"><img src="/png/13f883ae388680541d33f2366398124b.png"
border=0></a></td>
<td valign="top"><a href="/f/a/escape/level/2190">mod 14</a>
<br />by pieguy
<br /><b>difficulty</b>: 8.40
</td></tr>
<tr>
<td valign="top"><a href="/f/a/escape/level/1565"><img src="/png/3ebf6495687776b7fe92c23724153ee7.png"
border=0></a></td>
<td valign="top"><a href="/f/a/escape/level/1565">revenge of the computers 4</a>
<br />by pieguy
<br /><b>difficulty</b>: 8.40
</td></tr>
<tr>
<td valign="top"><a href="/f/a/escape/level/1873"><img src="/png/c646624525f3f734fee2564887d394a1.png"
border=0></a></td>
<td valign="top"><a href="/f/a/escape/level/1873">Nice Cote d'Azur International Airport (NCE) (mod)</a>
<br />by Tom 7 (mod by Eric119)
<br /><b>difficulty</b>: 8.33
</td></tr>
</table>
